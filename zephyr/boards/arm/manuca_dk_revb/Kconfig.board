## zephyr/boards/arm/manuca_dk_revb/Kconfig.board
```kconfig
config BOARD_MANUCA_DK_REVB
	bool "MANUCA Development Board Rev B"
	depends on SOC_STM32F767XX
	
	select USE_STM32_HAL_RNG
```

## zephyr/boards/arm/manuca_dk_revb/Kconfig.defconfig
```kconfig
if BOARD_MANUCA_DK_REVB

config BOARD
	default "manuca_dk_revb"

config UUID_ADDRESS
	hex "Address pointing to MCU's factory flashed UUID"
	default 0x1FF0F420

endif # BOARD_MANUCA_DK_REVB
```

## zephyr/boards/arm/manuca_dk_revb/manuca_dk_revb_defconfig
```kconfig
CONFIG_SOC_SERIES_STM32F7X=y
CONFIG_SOC_STM32F767XX=y
# 216MHz system clock
CONFIG_SYS_CLOCK_HW_CYCLES_PER_SEC=216000000

# Enable MPU
CONFIG_ARM_MPU=y

# Enable HW stack protection
CONFIG_HW_STACK_PROTECTION=y

# Enable UART
CONFIG_SERIAL=y

# Console
CONFIG_CONSOLE=y
CONFIG_UART_CONSOLE=y

# Enable Pinmux
CONFIG_PINMUX=y

# Enable GPIO
CONFIG_GPIO=y

# Clock Configuration
CONFIG_CLOCK_CONTROL=y

# System clock sourced from PLL
CONFIG_CLOCK_STM32_SYSCLK_SRC_PLL=y

# PLLCLK sourced from HSI
CONFIG_CLOCK_STM32_PLL_SRC_HSI=y

# Produce 216MHz for PLLCLK
CONFIG_CLOCK_STM32_PLL_M_DIVISOR=2
CONFIG_CLOCK_STM32_PLL_N_MULTIPLIER=54
CONFIG_CLOCK_STM32_PLL_P_DIVISOR=2
# Produce 48MHz for PLL48CLK
CONFIG_CLOCK_STM32_PLL_Q_DIVISOR=9
# Produce 216MHz for AHB 
CONFIG_CLOCK_STM32_AHB_PRESCALER=1
# Produce 27MHz for APB1
CONFIG_CLOCK_STM32_APB1_PRESCALER=2
# Produce 54MHz for APB2
CONFIG_CLOCK_STM32_APB2_PRESCALER=1

# Use LSE as RTC clock
CONFIG_COUNTER_RTC_STM32_CLOCK_LSE=y

# Enable Independent Watchdog on STM32 Family
CONFIG_IWDG_STM32=y
```

## zephyr/boards/shields/esp_32_xbee/Kconfig.defconfig
```kconfig
if SHIELD_ESP_32_XBEE

if NETWORKING

config WIFI_ESP
    default y
    depends on WIFI

choice WIFI_ESP_AT_VERSION
	default WIFI_ESP_AT_VERSION_2_0
	depends on WIFI_ESP
endchoice

endif # NETWORKING

endif # SHIELD_ESP_32_XBEE
```
